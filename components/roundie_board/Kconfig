## components/roundie_board/Kconfig
```kconfig
menu "Roundie board"

choice ROUNDIE_BOARD
    prompt "Board support package (compile-time)"
    default ROUNDIE_BOARD_WAVESHARE_S3_TOUCH_LCD_1_85B
    help
        Selects the board implementation under components/roundie_board/boards.
        Must match the ROUNDIE_BOARD CMake variable, which also chooses the
        board's sdkconfig defaults. See docs/board-support.md.

config ROUNDIE_BOARD_WAVESHARE_S3_TOUCH_LCD_1_85B
    bool "Waveshare ESP32-S3-Touch-LCD-1.85B"
    depends on IDF_TARGET_ESP32S3
endchoice

config ROUNDIE_BOARD_DIR
    string
    default "waveshare_s3_touch_lcd_1_85b" if ROUNDIE_BOARD_WAVESHARE_S3_TOUCH_LCD_1_85B

if ROUNDIE_BOARD_WAVESHARE_S3_TOUCH_LCD_1_85B
rsource "boards/waveshare_s3_touch_lcd_1_85b/Kconfig"
endif

endmenu

menu "Roundie LCD"

config ROUNDIE_LCD_STRIP_LINES
    int "LVGL partial draw buffer height in lines"
    range 20 60
    default 20
    help
        Compile-time experiment; firmware accepts only 20 or 60. Each draw
        buffer and the SPI transfer limit use 720 bytes per line of internal
        DMA memory.

config ROUNDIE_LVGL_CORE_IRAM
    bool "Place the LVGL refresh and draw core in IRAM"
    default n
    help
        Compile-time experiment measuring Flash fetch cost. Uses internal
        memory for the objects listed in main/lvgl_iram.lf.

config ROUNDIE_LCD_DOUBLE_BUFFER
    bool "Two internal LVGL draw buffers"
    default y
    help
        Compile-time partial-render experiment. Adds one more buffer of
        internal DMA memory. LVGL renders the alternate buffer while the
        previous one transfers; one transfer remains outstanding. Queue depth
        stays two.

endmenu
```

## components/roundie_board/boards/waveshare_s3_touch_lcd_1_85b/Kconfig
```kconfig
menu "Waveshare ESP32-S3-Touch-LCD-1.85B"

choice ROUNDIE_LCD_WRITE_CLOCK
    prompt "ST77916 write clock (compile-time only)"
    default ROUNDIE_LCD_WRITE_30MHZ
    help
        Bounded 1.85B profiles. ID reads always use 3 MHz. See
        docs/display-performance.md for timing and physical evidence limits.

config ROUNDIE_LCD_WRITE_3MHZ
    bool "3 MHz (historical baseline)"
config ROUNDIE_LCD_WRITE_10MHZ
    bool "10 MHz (conservative candidate)"
config ROUNDIE_LCD_WRITE_20MHZ
    bool "20 MHz (accepted 3E.2 fallback)"
config ROUNDIE_LCD_WRITE_30MHZ
    bool "30 MHz requested (26.667 MHz with the pinned 80 MHz divider)"
config ROUNDIE_LCD_WRITE_40MHZ
    bool "40 MHz (requires separate bounded device validation)"
endchoice

config ROUNDIE_LCD_WRITE_HZ
    int
    default 3000000 if ROUNDIE_LCD_WRITE_3MHZ
    default 10000000 if ROUNDIE_LCD_WRITE_10MHZ
    default 20000000 if ROUNDIE_LCD_WRITE_20MHZ
    default 30000000 if ROUNDIE_LCD_WRITE_30MHZ
    default 40000000 if ROUNDIE_LCD_WRITE_40MHZ

config ROUNDIE_GAUGE_DESIGN_CAPACITY_MAH
    int "BQ27220 Design Capacity to restore after a gauge reset (mAh, 0 = off)"
    range 0 6000
    default 0
    help
        The fitted cell's nominal capacity. When the gauge reports its
        3000 mAh reset default (its RAM was lost with the battery), the
        system worker initializes Design Capacity and Full Charge Capacity
        to this value once, in RAM only, with no access keys. A gauge that
        already reports this value is never written, so the learned FCC is
        kept. OTP is never programmed. See docs/bringup.md.

endmenu
```

## examples/usb_msc_ramdisk_probe/sdkconfig.defaults
```kconfig
CONFIG_IDF_TARGET="esp32s3"
CONFIG_PARTITION_TABLE_CUSTOM=y
CONFIG_PARTITION_TABLE_CUSTOM_FILENAME="../../partitions/rep.csv"
CONFIG_PARTITION_TABLE_FILENAME="../../partitions/rep.csv"
CONFIG_PARTITION_TABLE_OFFSET=0x8000
CONFIG_ESPTOOLPY_FLASHSIZE_16MB=y
CONFIG_ESPTOOLPY_FLASHMODE_DIO=y
CONFIG_ESPTOOLPY_FLASHFREQ_80M=y
CONFIG_BOOTLOADER_APP_ROLLBACK_ENABLE=y
CONFIG_SPIRAM=y
CONFIG_SPIRAM_MODE_OCT=y
CONFIG_SPIRAM_SPEED_80M=y
CONFIG_ESP_MAIN_TASK_STACK_SIZE=8192
CONFIG_FATFS_LFN_HEAP=y
CONFIG_FATFS_MAX_LFN=255
CONFIG_TINYUSB_CDC_ENABLED=y
CONFIG_TINYUSB_CDC_COUNT=1
CONFIG_TINYUSB_MSC_ENABLED=y
# CONFIG_TINYUSB_MTP_ENABLED is not set
```

## examples/usb_mtp_probe/sdkconfig.defaults
```kconfig
CONFIG_IDF_TARGET="esp32s3"
CONFIG_TINYUSB_CDC_ENABLED=y
CONFIG_TINYUSB_CDC_COUNT=1
CONFIG_TINYUSB_CDC_RX_BUFSIZE=2048
CONFIG_TINYUSB_CDC_TX_BUFSIZE=2048
CONFIG_TINYUSB_CDC_EP_BUFSIZE=64
CONFIG_TINYUSB_MTP_ENABLED=y
CONFIG_TINYUSB_MTP_EP_BUFSIZE=4096
CONFIG_TINYUSB_MTP_MAX_STORAGES=1
CONFIG_TINYUSB_MTP_MAX_OBJECTS=32
# CONFIG_TINYUSB_MSC_ENABLED is not set
# CONFIG_TINYUSB_MTP_TRACE_WRITES is not set
```

## examples/usb_otg_recovery_probe/sdkconfig.defaults
```kconfig
CONFIG_IDF_TARGET="esp32s3"
CONFIG_PARTITION_TABLE_CUSTOM=y
CONFIG_PARTITION_TABLE_CUSTOM_FILENAME="../../partitions/rep.csv"
CONFIG_PARTITION_TABLE_FILENAME="../../partitions/rep.csv"
CONFIG_PARTITION_TABLE_OFFSET=0x8000
CONFIG_ESPTOOLPY_FLASHSIZE_16MB=y
CONFIG_ESPTOOLPY_FLASHMODE_DIO=y
CONFIG_ESPTOOLPY_FLASHFREQ_80M=y
CONFIG_BOOTLOADER_APP_ROLLBACK_ENABLE=y
CONFIG_TINYUSB_CDC_ENABLED=y
CONFIG_TINYUSB_CDC_COUNT=1
# CONFIG_TINYUSB_MSC_ENABLED is not set
# CONFIG_TINYUSB_MTP_ENABLED is not set
```

## main/Kconfig.projbuild
```kconfig
menu "Roundie system"

config ROUNDIE_APP_RUNTIME
    bool "Enable the native application runtime, packages and launcher"
    default n
    depends on BOOTLOADER_APP_ROLLBACK_ENABLE
    help
        Application Executor, package registry and launcher. Independent of
        the development USB transports. Requires the REP partition layout.

config ROUNDIE_POWER
    bool "Enable screen off, the BOOT power menu and light sleep"
    default n
    help
        REP Section 17 PowerManager in normal mode. BOOT (GPIO0, input only)
        opens a menu with Sleep, Screen off, Restart, Safe Mode and Cancel.
        Light sleep wakes on touch INT or BOOT; USB Serial/JTAG disconnects
        while asleep. Safe Mode does not use it. No software power-off.

config ROUNDIE_POWER_SCREEN_TIMEOUT_SECONDS
    int "Seconds without touch or BOOT before the screen turns off"
    range 0 600
    default 30
    depends on ROUNDIE_POWER
    help
        0 disables automatic screen off. Rendering continues while dark.

config ROUNDIE_POWER_SLEEP_SAFETY_SECONDS
    int "Light-sleep safety timer in seconds"
    range 0 86400
    default 300
    depends on ROUNDIE_POWER
    help
        A timer wake after this long returns USB recovery with the screen off.
        Keeps a development board reachable if touch and BOOT wake fail.
        0 sleeps until touch or BOOT.

endmenu

menu "Roundie development diagnostics"

config ROUNDIE_RECOVERY_USB
    bool "Enable bounded USB Serial/JTAG recovery commands"
    default y
    depends on ESP_CONSOLE_SECONDARY_USB_SERIAL_JTAG
    help
        RS1 status and explicit guarded recovery operations. Shares the sole
        diagnostic reader. Does not enable RTC writes or firmware uploads.

config ROUNDIE_DEV_TIME_SYNC
    bool "Enable development USB Serial/JTAG RTC commands"
    default n
    depends on ESP_CONSOLE_SECONDARY_USB_SERIAL_JTAG
    help
        Allows a physically connected host to read RTC status and explicitly
        overwrite RTC UTC time. No authentication. Disable for production.

config ROUNDIE_DEV_OTA
    bool "Enable development USB Serial/JTAG OTA commands (unauthenticated)"
    default n
    depends on ROUNDIE_DEV_TIME_SYNC && BOOTLOADER_APP_ROLLBACK_ENABLE
    help
        Physically connected hosts may overwrite the inactive app slot and OTA
        metadata. Disable for production. Requires the REP partition layout.

config ROUNDIE_OTA_TEST_UNCONFIRMED_RESET
    bool "ARM one automatic rollback experiment in this development image"
    default n
    depends on ROUNDIE_DEV_OTA
    help
        DANGEROUS TEST IMAGE: never confirms itself. Only on PENDING_VERIFY
        with a verified VALID fallback, resets once to exercise automatic
        ABORTED rollback. Otherwise fails self-test without a reset loop.
        Requires separate hardware-test authorization. Never use for releases.

config ROUNDIE_DEV_ELF
    bool "Enable trusted development ELF staging and explicit execution"
    default n
    depends on ROUNDIE_DEV_OTA && ROUNDIE_APP_RUNTIME
    help
        RE1 bounded transfer to /storage/dev/hello.elf and explicit RUN by
        SHA-256. Trusted development code only; native code is unisolated.
        No discovery, autostart, packages, MTP or arbitrary path access.

config ROUNDIE_BOOT_GUARD_TEST
    bool "Enable bounded BootGuard development fault injection"
    default n
    depends on ROUNDIE_DEV_OTA
    help
        Adds RS1 FAULT with exact running ELF identity. Only a stable VALID
        image can arm three incomplete-boot software resets. Safe Mode cancels
        all remaining faults. Also adds RS1 HANG, which stops the system
        worker until its task watchdog panics, in any boot state including
        Safe Mode. Must use a version ending in -boot-test.
        Disable in normal firmware; never causes a fault merely by booting.

config ROUNDIE_DEV_POWER
    bool "Enable development USB Serial/JTAG power commands"
    default n
    depends on ROUNDIE_POWER && ROUNDIE_RECOVERY_USB
    help
        RW1 status, screen off/on and timed light sleep (1 to 3600 s).
        Unauthenticated; disable for production.

config ROUNDIE_DEV_PACKAGES
    bool "Enable trusted development RPK1 package management"
    default y
    depends on ROUNDIE_DEV_ELF
    help
        RP1 bounded package transport, explicit install, list, launch and remove.
        No authentication, signing, isolation or application autostart. Disable
        together with the other development interfaces for production; the
        launcher stays available through ROUNDIE_APP_RUNTIME.

config ROUNDIE_USB_STORAGE
    bool "USB storage mode: a FAT drive in PSRAM over USB-OTG mass storage"
    default n
    depends on ROUNDIE_APP_RUNTIME
    help
        Gate G2 of docs/usb-storage-mode-plan.md. A one-shot boot mode (RS1
        STORAGE) takes the internal USB PHY for mass storage and returns to
        USB Serial/JTAG with a planned restart. Normal mode is unchanged.

config ROUNDIE_DEV_STORAGE_CDC
    bool "Development: CDC status port in USB storage mode"
    default n
    depends on ROUNDIE_USB_STORAGE
    help
        Adds a CDC port that prints one status line a second and accepts the
        word EXITNOW to leave the mode. The USB Serial/JTAG diagnostics are
        off in this mode, so this is the only way to observe it from a host.
        Disable for production.

config ROUNDIE_BOOT_STABILITY_SECONDS
    int "BootGuard operational stability window (seconds)"
    range 5 30
    default 10

endmenu
```
